## samples/bluetooth/bap_broadcast_sink/boards/promicro_nrf52840_nrf52840_uf2.conf
```kconfig
# Use USB Audio as audio sink
CONFIG_USE_USB_AUDIO_OUTPUT=y
CONFIG_SAMPLE_USBD_PRODUCT="USB Broadcast Sink sample"
CONFIG_CDC_ACM_SERIAL_INITIALIZE_AT_BOOT=n
CONFIG_CDC_ACM_SERIAL_ENABLE_AT_BOOT=n
```
